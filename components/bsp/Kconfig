## components/bsp/Kconfig
```kconfig
menu "I2C configuration"
    
menu "Pin Configuration"
    config I2C_SDA
        int "I2C_SDA"
        default "16"
    config I2C_SCL
        int "I2C_SCL"
        default "17"
endmenu

config I2C_FREQ
    int "I2C Frequency"
    default "100000"
    help
        The I2C Frequency in Herz.
	
endmenu

menu "I2S configuration"
    
choice MCLK_SUPPORT
	prompt "I2S MCLK"
	default GPIO_SUPPORT

config PLL_SUPPORT
	bool "PLL_SUPPORT"
	help
		MCLK is generated by PLL.

config GPIO_SUPPORT
	bool "GPIO_SUPPORT"
	help
		MCLK is generated by GPIO.
endchoice

menu "Pin Configuration"
    config I2S_SCLK
        int "I2S_SCLK"
        default "33"
    config I2S_LRCK
        int "I2S_LRCK"
        default "25"
    config I2S_DOUT
        int "I2S_DOUT"
        default "26"
    config I2S_DIN
        int "I2S_DIN"
        default "27"
endmenu
	
endmenu
```

## components/camera/Kconfig
```kconfig
menu "Camera configuration"

config ENABLE_TEST_PATTERN
	bool "Enable test pattern on camera output"
	default n
	help
		Configure the camera module to output test pattern instead of live image.
		
		Use this option to troubleshoot image issues like noise,
		distortion, not legible and missing live image.
		Instead, module will generate regular vertical bars 
		in shades from dark to white.
        
choice ESP32_CAMERA
	prompt "Camera Module"
	default OV2640_SUPPORT

config OV2640_SUPPORT
	bool "OV2640 Support"
	help
		Enable this option if you want to use the OV2640.
		Disable this option to safe memory.

config OV7725_SUPPORT
	bool "OV7725 Support"
	help
		Enable this option if you want to use the OV7725.
		Disable this option to safe memory.
endchoice
     
config XCLK_FREQ
    int "XCLK Frequency"
    default "20000000"
    help
        The XCLK Frequency in Herz.
        
menu "Pin Configuration"
    config CAM_D0
        int "CAM_D0"
        default "4"
    config CAM_D1
        int "CAM_D1"
        default "5"
    config CAM_D2
        int "CAM_D2"
        default "18"
    config CAM_D3
        int "CAM_D3"
        default "19"
    config CAM_D4
        int "CAM_D4"
        default "36"
    config CAM_D5
        int "CAM_D5"
        default "39"
    config CAM_D6
        int "CAM_D6"
        default "34"
    config CAM_D7
        int "CAM_D7"
        default "35"
    config CAM_XCLK
        int "CAM_XCLK"
        default "21"
    config CAM_PCLK
        int "CAM_PCLK"
        default "22"
    config CAM_VSYNC
        int "CAM_VSYNC"
        default "25"
    config CAM_HREF
        int "CAM_HREF"
        default "23"
    config CAM_RESET
        int "CAM_RESET"
        default "2"
endmenu
	
endmenu
```
